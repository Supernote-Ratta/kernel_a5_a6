## drivers/net/wireless/bcmdhd/Kconfig
```kconfig
config BCMDHD
	tristate "Broadcom FullMAC wireless cards support"
	default m
	---help---
	  This module adds support for wireless adapters based on
	  Broadcom FullMAC chipset.

config BCMDHD_FW_PATH
	depends on BCMDHD
	string "Firmware path"
	default "/system/etc/firmware/fw_bcmdhd.bin"
	---help---
	  Path to the firmware file.

config BCMDHD_NVRAM_PATH
	depends on BCMDHD
	string "NVRAM path"
	default "/system/etc/firmware/nvram.txt"
	---help---
	  Path to the calibration file.

config BCMDHD_WEXT
	bool "Enable WEXT support"
	depends on BCMDHD && CFG80211 = n
	select WIRELESS_EXT
	select WEXT_PRIV
	help
	  Enables WEXT support

config DHD_USE_STATIC_BUF
	bool "Enable memory preallocation"
	depends on BCMDHD
	default n
	---help---
	  Use memory preallocated in platform

config POWER_MGMT_IN_DRIVER
        depends on  BCMDHD
        bool "Power Managerment Implement in Driver"
        default y
        ---help---
            Support Power Management in Driver

choice
	prompt "Enable Chip Interface"
	depends on BCMDHD
	---help---
		Enable Chip Interface.
config BCMDHD_SDIO
		bool "SDIO bus interface support"
		depends on BCMDHD

config BCMDHD_PCIE
		bool "PCIe bus interface support"
		depends on BCMDHD && PCI
endchoice

choice
	depends on BCMDHD && BCMDHD_SDIO
	prompt "Interrupt type"
	---help---
		Interrupt type
config BCMDHD_OOB
	depends on BCMDHD && BCMDHD_SDIO
	bool "Out-of-Band Interrupt"
	---help---
		Interrupt from WL_HOST_WAKE.
config BCMDHD_SDIO_IRQ
	depends on BCMDHD && BCMDHD_SDIO
	bool "In-Band Interrupt"
	---help---
	  Interrupt from SDIO DAT[1]
endchoice

config DHD_OF_SUPPORT
	bool "Use in-drive platform device"
	depends on BCMDHD && !POWER_MGMT_IN_DRIVER
	default n
```
